## conf/layer.conf
```bitbake
# Board specific layer configuration for meta-mender
# Copyright 2016 Mirza Krak

# We have a conf and classes directory, add to BBPATH
BBPATH .= ":${LAYERDIR}"

# We have recipes-* directories, add to BBFILES
BBFILES += "${LAYERDIR}/recipes-*/*/*.bb \
	${LAYERDIR}/recipes-*/*/*.bbappend"

BBFILE_COLLECTIONS += "mender-m3ulcb"
BBFILE_PATTERN_mender-m3ulcb = "^${LAYERDIR}/"
BBFILE_PRIORITY_mender-m3ulcb = "10"
```
